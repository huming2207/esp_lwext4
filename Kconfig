## Kconfig
```kconfig
# SPDX-FileCopyrightText: 2026 esp_lwext4 contributors
# SPDX-License-Identifier: BSD-3-Clause

menu "lwext4 configuration"

    choice LWEXT4_FEATURE_SET
        prompt "Supported on-disk feature set"
        default LWEXT4_FEATURE_SET_EXT3
        help
            Select the family of on-disk feature flags accepted and created by
            lwext4. The ext4 feature set requires an extents implementation
            (see "Extents implementation" below).

        config LWEXT4_FEATURE_SET_EXT2
            bool "ext2"

        config LWEXT4_FEATURE_SET_EXT3
            bool "ext3 (recommended)"

        config LWEXT4_FEATURE_SET_EXT4
            bool "ext4 (requires an extents implementation)"
            depends on LWEXT4_EXTENTS_MIT || LWEXT4_EXTENTS_UPSTREAM
    endchoice

    config LWEXT4_JOURNALING_ENABLE
        bool "Enable journaling"
        default y
        help
            Maps to lwext4 CONFIG_JOURNALING_ENABLE. Keep this enabled for the
            journaled ext3 configuration.

    choice LWEXT4_EXTENTS_IMPLEMENTATION
        prompt "Extents implementation"
        default LWEXT4_EXTENTS_MIT
        help
            Extent-mapped files (the ext4 feature set) need an extent-tree
            implementation. This component ships an experimental MIT port
            based on ext4-rs by yuoo655, or can compile lwext4's upstream
            GPL-2.0-or-later implementation instead. The explicit build list
            excludes lwext4's GPL extent object in the MIT configuration.

        config LWEXT4_EXTENTS_NONE
            bool "Disabled (ext2/ext3 only)"

        config LWEXT4_EXTENTS_MIT
            bool "Experimental ext4-rs-based MIT port"
            help
                Writable extent-tree mutation requires journaling to be
                enabled here and an active journal on the mounted filesystem.
                Mutation fails with ENOTSUP otherwise. Unwritten-extent
                conversion is not implemented. See doc/CAVEATS.md before
                production use.

        config LWEXT4_EXTENTS_UPSTREAM
            bool "Upstream lwext4 (GPL-2.0-or-later)"
            help
                Compiles the GPL-licensed ext4_extent.c from the vendored
                lwext4 tree into the firmware. The resulting binary must
                comply with GPL-2.0-or-later.
    endchoice

    # These hidden symbols are deliberately fixed off. They are retained so
    # every externally supplied lwext4 CONFIG_* input has an explicit mapping.
    config LWEXT4_XATTR_ENABLE
        bool
        default n
        help
            Maps to CONFIG_XATTR_ENABLE. The GPL xattr source is not built.

    config LWEXT4_EXTENTS_ENABLE
        bool
        default y if LWEXT4_EXTENTS_MIT || LWEXT4_EXTENTS_UPSTREAM
        default n
        help
            Maps to CONFIG_EXTENTS_ENABLE. Derived from the extents
            implementation choice; do not set directly.

    config LWEXT4_HAVE_OWN_ERRNO
        bool "Use lwext4's errno constants"
        default n
        help
            Maps to CONFIG_HAVE_OWN_ERRNO. When disabled, lwext4 uses the C
            library errno definitions supplied by ESP-IDF.

    config LWEXT4_DEBUG_PRINTF
        bool "Enable lwext4 debug printf"
        default n
        help
            Maps to CONFIG_DEBUG_PRINTF. Runtime output is also controlled by
            lwext4's debug mask.

    config LWEXT4_DEBUG_ASSERT
        bool "Enable lwext4 assertions"
        default y
        help
            Maps to CONFIG_DEBUG_ASSERT.

    config LWEXT4_HAVE_OWN_ASSERT
        bool "Use lwext4's spin-loop assertion implementation"
        default n
        depends on LWEXT4_DEBUG_ASSERT
        help
            Maps to CONFIG_HAVE_OWN_ASSERT. Disabled uses the standard assert
            implementation provided by ESP-IDF/Newlib.

    config LWEXT4_BLOCK_DEV_ENABLE_STATS
        bool "Collect block-device statistics"
        default y
        help
            Maps to CONFIG_BLOCK_DEV_ENABLE_STATS.

    config LWEXT4_BLOCK_DEV_CACHE_SIZE
        int "Block-cache entry count"
        range 1 1024
        default 8
        help
            Maps to CONFIG_BLOCK_DEV_CACHE_SIZE. Cache data buffers are
            allocated dynamically; RAM use also depends on filesystem block
            size.

    config LWEXT4_FORMAT_ROUND_TO_FULL_GROUPS
        bool "Round formatted length down to complete block groups"
        default y
        help
            The pinned lwext4 formatter records an incorrect free-block count
            in the final partial block group's descriptor: the bitmap
            correctly marks out-of-range blocks as used, but the descriptor is
            computed from a full group. e2fsck therefore reports a free-block
            count mismatch on any device whose size is not a multiple of the
            block-group size.

            When enabled, the port rounds the filesystem length down to a
            whole number of block groups before calling ext4_mkfs(). This
            produces metadata that e2fsck accepts, at the cost of up to one
            block group of capacity (128 MiB for 4096-byte blocks). Disable to
            keep the full device size, but be aware that the resulting
            metadata is inconsistent: lwext4 runs, but Linux filesystem checks
            report a free-block count mismatch. Treat this option as
            diagnostic-only for production or interoperability use.

    config LWEXT4_EXT4_MAX_BLOCKDEV_NAME
        int "Maximum block-device name length"
        range 1 255
        default 32
        help
            Maps to CONFIG_EXT4_MAX_BLOCKDEV_NAME.

    config LWEXT4_EXT4_BLOCKDEVS_COUNT
        int "Maximum registered block-device count"
        range 1 32
        default 2
        help
            Maps to CONFIG_EXT4_BLOCKDEVS_COUNT.

    config LWEXT4_EXT4_MAX_MP_NAME
        int "Maximum mount-point name length"
        range 1 255
        default 32
        help
            Maps to CONFIG_EXT4_MAX_MP_NAME.

    config LWEXT4_EXT4_MOUNTPOINTS_COUNT
        int "Maximum mounted-filesystem count"
        range 1 32
        default 2
        help
            Maps to CONFIG_EXT4_MOUNTPOINTS_COUNT.

    config LWEXT4_HAVE_OWN_OFLAGS
        bool "Use lwext4's file-open flag constants"
        default n
        help
            Maps to CONFIG_HAVE_OWN_OFLAGS. Disabled uses Newlib's fcntl and
            unistd definitions.

    config LWEXT4_MAX_TRUNCATE_SIZE
        int "Maximum bytes truncated per transaction"
        range 4096 2147483647
        default 16777216
        help
            Maps to CONFIG_MAX_TRUNCATE_SIZE. lwext4 splits larger truncates
            into transactions no larger than this value.

    config LWEXT4_VFS_GROW_BUFFER_SIZE
        int "VFS file-growth zero-fill buffer size (bytes)"
        range 4096 262144
        default 16384
        help
            Buffer used by the VFS adapter to materialize zero-filled ranges
            when truncate() or pwrite() extends a file beyond its current
            size. lwext4 commits one journal transaction per write call, so a
            larger buffer reduces the number of transactions during growth at
            the cost of one buffer per writable registered VFS mount. The
            buffer is allocated once at VFS registration and freed at
            unregistration. Multiples of the filesystem block size are
            recommended.

    config LWEXT4_UNALIGNED_ACCESS
        bool "Allow native unaligned memory access"
        default n
        help
            Maps to CONFIG_UNALIGNED_ACCESS. Enable only after proving that the
            selected ESP target and compiler safely support lwext4's unaligned
            access patterns.

    choice LWEXT4_USE_USER_MALLOC
        prompt "Memory used for lwext4 allocations"
        default LWEXT4_USE_INTERNAL_SRAM
        help
            Select the ESP-IDF heap capability used by lwext4's allocations.
            All three modes provide the ext4_user_malloc, ext4_user_calloc,
            ext4_user_realloc, and ext4_user_free hooks required by lwext4.

        config LWEXT4_USE_INTERNAL_SRAM
            bool "Internal SRAM"
            help
                Allocate lwext4 memory from byte-addressable internal SRAM.

        config LWEXT4_USE_PSRAM
            bool "PSRAM only"
            depends on SPIRAM
            help
                Allocate lwext4 memory from byte-addressable PSRAM only.
                Allocation fails if the requested block cannot be allocated
                from PSRAM.

        config LWEXT4_USE_PREFER_PSRAM
            bool "Prefer PSRAM, then internal SRAM"
            depends on SPIRAM
            help
                Try byte-addressable PSRAM first and fall back to
                byte-addressable internal SRAM when PSRAM allocation fails.
    endchoice

endmenu
```

## test_apps/build_smoke/sdkconfig.defaults
```kconfig
# SPDX-FileCopyrightText: 2026 esp_lwext4 contributors
# SPDX-License-Identifier: BSD-3-Clause

CONFIG_LWEXT4_FEATURE_SET_EXT3=y
CONFIG_LWEXT4_JOURNALING_ENABLE=y
CONFIG_LWEXT4_XATTR_ENABLE=n
CONFIG_LWEXT4_EXTENTS_ENABLE=n
CONFIG_LWEXT4_USE_INTERNAL_SRAM=y
```
